## boards/kelvin_esp32/board.yml
```yaml
board:
  name: kelvin_esp32
  full_name: DOIT ESP32-DevKit-V1
  vendor: others
  socs:
    - name: esp32
```

## boards/kelvin_esp32_scratch/Kconfig
```kconfig
config HEAP_MEM_POOL_ADD_SIZE_BOARD
    int
    default 4096 if BOARD_KELVIN_ESP32_SCRATCH_ESP32_PROCPU
    default 256 if BOARD_KELVIN_ESP32_SCRATCH_ESP32_APPCPU
```

## boards/kelvin_esp32_scratch/board.yml
```yaml
board:
  name: kelvin_esp32_scratch
  full_name: Kelvin ESP32 Scratch Board
  vendor: others
  socs:
    - name: esp32
```

## boards/kelvin_esp32_scratch/kelvin_esp32_scratch_procpu_defconfig
```kconfig
CONFIG_GPIO=y
CONFIG_SERIAL=y
CONFIG_CONSOLE=y
CONFIG_UART_CONSOLE=y
CONFIG_ESP32_USE_UNSUPPORTED_REVISION=y
```

## drivers/led_sensor/Kconfig
```kconfig
menuconfig LED_SENSOR
    bool "Simple LED sensor driver"
    default y
    depends on DT_HAS_KELVIN_LED_SENSOR_ENABLED
    select GPIO
    select SENSOR
    help
      Enable the simple on-board LED sensor driver.
```

## dts/bindings/sensor/kelvin,led-sensor.yaml
```yaml
description: Simple on-board LED sensor driver

compatible: "kelvin,led-sensor"

properties:
  led-gpios:
    type: phandle-array
    required: true
```
